## _glue-site/credentials/sample.yaml
```yaml
# Glue Framework
# Copyright (C) 2015 Joby Elliott
#
# This file is not licensed along with the rest of the Glue Framework. It is
# released into the public domain, and you are free to modify or re-use it
# in any way.
#
# How credentials are managed:
# These files can be loaded via a call like \glue\Credentials::get('sample/DSN')
# Credentials can be stored directly in this folder, or placed in environment
# specific subfolders. Environment-specific credentials will always take
# precedence.
# For example, if you have a staging site with environment.yaml edited to make
# Conf/environment/type be "staging" any credentials files in a folder called
# "staging" would be used on that site instead.
sample:#change this to match the filename
  DSN: "mysql:host=db.server.com;dbname=db_name"
  username: "db_user"
  password: "yourStrongPassword"
```
